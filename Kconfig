## Kconfig
```kconfig
menu "SparkFun u-blox GNSS v4"

    config SFE_UBLOX_GNSS_I2C_CLOCK_HZ
        int "I2C clock speed (Hz)"
        range 10000 400000
        default 400000
        help
            The I2C (SCL) clock speed used for the GNSS module. u-blox modules support up to 400kHz.

    config SFE_UBLOX_GNSS_I2C_TIMEOUT_MS
        int "I2C transaction timeout (ms)"
        range 10 5000
        default 100
        help
            Timeout for each I2C transaction. Prevents the task from hanging if the module is disconnected.

endmenu
```

## idf_examples/CallbackExample1_NAVHPPOSLLH/main/Kconfig.projbuild
```kconfig
menu "Example Configuration"

    config EXAMPLE_I2C_SDA_GPIO
        int "I2C SDA GPIO"
        range 0 63
        default 21
        help
            GPIO connected to the GNSS module's SDA pin.

    config EXAMPLE_I2C_SCL_GPIO
        int "I2C SCL GPIO"
        range 0 63
        default 22
        help
            GPIO connected to the GNSS module's SCL pin.

endmenu
```

## idf_examples/DataloggingExample1_RAWX_and_SFRBX/main/Kconfig.projbuild
```kconfig
menu "Example Configuration"

    config EXAMPLE_I2C_SDA_GPIO
        int "I2C SDA GPIO"
        range 0 63
        default 21
        help
            GPIO connected to the GNSS module's SDA pin.

    config EXAMPLE_I2C_SCL_GPIO
        int "I2C SCL GPIO"
        range 0 63
        default 22
        help
            GPIO connected to the GNSS module's SCL pin.

    config EXAMPLE_SD_SCK_GPIO
        int "microSD SPI SCK GPIO"
        range 0 63
        default 18

    config EXAMPLE_SD_POCI_GPIO
        int "microSD SPI POCI (MISO) GPIO"
        range 0 63
        default 19

    config EXAMPLE_SD_PICO_GPIO
        int "microSD SPI PICO (MOSI) GPIO"
        range 0 63
        default 23

    config EXAMPLE_SD_CS_GPIO
        int "microSD SPI chip select GPIO"
        range 0 63
        default 5
        help
            Default 5 matches the SparkFun Thing Plus C (and the Arduino example).

    config EXAMPLE_LED_GPIO
        int "LED GPIO (-1 to disable)"
        range -1 63
        default 13
        help
            The LED is flashed each time data is written to the SD card. Default 13 matches the SparkFun Thing Plus C LED.

endmenu
```

## idf_examples/DataloggingExample2_DataLogger_IoT_SDIO/main/Kconfig.projbuild
```kconfig
menu "Example Configuration"

    config EXAMPLE_GNSS_SPI_SCK_GPIO
        int "GNSS SPI SCK GPIO"
        range 0 63
        default 18

    config EXAMPLE_GNSS_SPI_POCI_GPIO
        int "GNSS SPI POCI (MISO) GPIO"
        range 0 63
        default 19

    config EXAMPLE_GNSS_SPI_PICO_GPIO
        int "GNSS SPI PICO (MOSI) GPIO"
        range 0 63
        default 23

    config EXAMPLE_GNSS_CS_GPIO
        int "GNSS SPI chip select GPIO"
        range 0 63
        default 33
        help
            Connect the ZED-F9P CS pin to DataLogger IoT pin 33.

    config EXAMPLE_IMU_CS_GPIO
        int "IMU chip select GPIO (-1 if none)"
        range -1 63
        default 5
        help
            The DataLogger IoT - 9DoF ISM330 IMU CS. Driven high so the IMU does not interfere with the SPI bus.

    config EXAMPLE_MAG_CS_GPIO
        int "Magnetometer chip select GPIO (-1 if none)"
        range -1 63
        default 27
        help
            The DataLogger IoT - 9DoF MMC5983 magnetometer CS. Driven high so the magnetometer does not interfere with the SPI bus.

    config EXAMPLE_EN_3V3_SW_GPIO
        int "3.3V_SW regulator enable GPIO (-1 if none)"
        range -1 63
        default 32
        help
            Powers the microSD card and the GNSS on the DataLogger IoT.

    config EXAMPLE_STAT_LED_GPIO
        int "STAT LED GPIO (-1 to disable)"
        range -1 63
        default 25
        help
            The STAT LED is flashed each time data is written to the SD card.

    config EXAMPLE_SDMMC_4BIT
        bool "Use 4-bit SDIO (SDMMC) mode"
        default y
        help
            Use all four SD data lines. Disable to use 1-bit mode.

    config EXAMPLE_SDMMC_HIGHSPEED
        bool "Use SDMMC high speed (40MHz) mode"
        default n
        help
            The default is 20MHz - the same as the Arduino SD_MMC library. High speed mode doubles the clock
            but needs a card which supports it and good signal integrity.

endmenu
```

## idf_examples/PollingExample2_PositionVelocityTime_Serial/main/Kconfig.projbuild
```kconfig
menu "Example Configuration"

    config EXAMPLE_UART_PORT_NUM
        int "UART port number"
        range 1 2
        default 1
        help
            The UART connected to the GNSS module. (UART0 is usually the console.)

    config EXAMPLE_UART_BAUD_RATE
        int "UART baud rate"
        default 38400
        help
            u-blox X20, F9 and M10 modules default to 38400 baud.

    config EXAMPLE_UART_TX_GPIO
        int "UART TX GPIO (connect to GNSS RX)"
        range 0 63
        default 17

    config EXAMPLE_UART_RX_GPIO
        int "UART RX GPIO (connect to GNSS TX)"
        range 0 63
        default 16

endmenu
```

## idf_examples/PollingExample3_PositionVelocityTime_SPI/main/Kconfig.projbuild
```kconfig
menu "Example Configuration"

    config EXAMPLE_SPI_SCK_GPIO
        int "SPI SCK GPIO"
        range 0 63
        default 18

    config EXAMPLE_SPI_POCI_GPIO
        int "SPI POCI (MISO) GPIO"
        range 0 63
        default 19

    config EXAMPLE_SPI_PICO_GPIO
        int "SPI PICO (MOSI) GPIO"
        range 0 63
        default 23

    config EXAMPLE_SPI_CS_GPIO
        int "SPI chip select GPIO"
        range 0 63
        default 4
        help
            GPIO connected to the GNSS module's chip select pin. Default 4 matches the Arduino example.

endmenu
```
